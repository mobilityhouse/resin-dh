## layers/meta-dhcom_imx6/conf/layer.conf
```bitbake
# We have a conf and classes directory, add to BBPATH
BBPATH .= ":${LAYERDIR}"

# We have a packages directory, add to BBFILES
BBFILES += "${LAYERDIR}/recipes-*/*/*.bb \
            ${LAYERDIR}/recipes-*/*/*.bbappend"

BBFILE_COLLECTIONS += "dhcom_imx6"
BBFILE_PATTERN_dhcom_imx6 := "^${LAYERDIR}/"
BBFILE_PRIORITY_dhcom_imx6 = "6"

LAYERDEPENDS_dhcom_imx6 = "core fsl-arm"
```

## layers/meta-dhcom_imx6/conf/machine/dhcom2bimx6d.conf
```bitbake
#@TYPE: Machine
#@NAME: DHCOM i.MX6 Dual
#@SOC: i.MX6D
#@DESCRIPTION: Machine configuration for DHCOM i.MX6 Dual HW200

require conf/machine/include/dhcom_imx6-common.inc

# Dual is a Quad internally but dual core.
SOC_FAMILY = "mx6:mx6q"

UBOOT_CONFIG ??= "d"
UBOOT_CONFIG[d] = "dh_imx6q_config"

KERNEL_DEVICETREE = "imx6d-dhcom2B-pdk1.dtb"

do_rootfs[depends] += "imx6-dhcom-pdk1-ulinuxenvtxt:do_deploy"
```

## layers/meta-dhcom_imx6/conf/machine/dhcom2bimx6dl.conf
```bitbake
#@TYPE: Machine
#@NAME: DHCOM i.MX6 DualLite
#@SOC: i.MX6dl
#@DESCRIPTION: Machine configuration for DHCOM i.MX6 DualLite HW200

require conf/machine/include/dhcom_imx6-common.inc


SOC_FAMILY = "mx6:mx6dl"

UBOOT_CONFIG ??= "dl"
UBOOT_CONFIG[dl] = "dh_imx6dl_config"

KERNEL_DEVICETREE = "imx6dl-dhcom2B-pdk1.dtb"

do_rootfs[depends] += "imx6-dhcom-pdk1-ulinuxenvtxt:do_deploy"
```

## layers/meta-dhcom_imx6/conf/machine/dhcom2bimx6q.conf
```bitbake
#@TYPE: Machine
#@NAME: DHCOM i.MX6 Quad
#@SOC: i.MX6Q
#@DESCRIPTION: Machine configuration for DHCOM i.MX6 Quad HW200

require conf/machine/include/dhcom_imx6-common.inc


SOC_FAMILY = "mx6:mx6q"

UBOOT_CONFIG ??= "q"
UBOOT_CONFIG[q] = "dh_imx6q_config"

KERNEL_DEVICETREE = "imx6q-dhcom2B-pdk1.dtb"

do_rootfs[depends] += "imx6-dhcom-pdk1-ulinuxenvtxt:do_deploy"
```

## layers/meta-dhcom_imx6/conf/machine/dhcom2bimx6s.conf
```bitbake
#@TYPE: Machine
#@NAME: DHCOM i.MX6 Solo
#@SOC: i.MX6S
#@DESCRIPTION: Machine configuration for DHCOM i.MX6 Solo HW200

require conf/machine/include/dhcom_imx6-common.inc

# Solo is a Duallite internally but single core.
SOC_FAMILY = "mx6:mx6dl"

UBOOT_CONFIG ??= "solo"
UBOOT_CONFIG[solo] = "dh_imx6s_config"

KERNEL_DEVICETREE = "imx6s-dhcom2B-pdk1.dtb"

do_rootfs[depends] += "imx6-dhcom-pdk1-ulinuxenvtxt:do_deploy"
```

## layers/meta-dhcom_imx6/conf/machine/dhcom3bimx6d.conf
```bitbake
#@TYPE: Machine
#@NAME: DHCOM i.MX6 Dual
#@SOC: i.MX6D
#@DESCRIPTION: Machine configuration for DHCOM i.MX6 Dual HW300

require conf/machine/include/dhcom_imx6-common.inc

# Dual is a Quad internally but dual core.
SOC_FAMILY = "mx6:mx6q"

UBOOT_CONFIG ??= "d"
UBOOT_CONFIG[d] = "dh_imx6q_config"

KERNEL_DEVICETREE = "imx6d-dhcom3B-pdk2.dtb"

do_rootfs[depends] += "imx6-dhcom-pdk2-ulinuxenvtxt:do_deploy"
```

## layers/meta-dhcom_imx6/conf/machine/dhcom3bimx6dl.conf
```bitbake
#@TYPE: Machine
#@NAME: DHCOM i.MX6 DualLite
#@SOC: i.MX6dl
#@DESCRIPTION: Machine configuration for DHCOM i.MX6 DualLite HW300

require conf/machine/include/dhcom_imx6-common.inc


SOC_FAMILY = "mx6:mx6dl"

UBOOT_CONFIG ??= "dl"
UBOOT_CONFIG[dl] = "dh_imx6dl_config"

KERNEL_DEVICETREE = "imx6dl-dhcom3B-pdk2.dtb"

do_rootfs[depends] += "imx6-dhcom-pdk2-ulinuxenvtxt:do_deploy"
```

## layers/meta-dhcom_imx6/conf/machine/dhcom3bimx6q.conf
```bitbake
#@TYPE: Machine
#@NAME: DHCOM i.MX6 Quad
#@SOC: i.MX6Q
#@DESCRIPTION: Machine configuration for DHCOM i.MX6 Quad HW300

require conf/machine/include/dhcom_imx6-common.inc


SOC_FAMILY = "mx6:mx6q"

UBOOT_CONFIG ??= "q"
UBOOT_CONFIG[q] = "dh_imx6q_config"

KERNEL_DEVICETREE = "imx6q-dhcom3B-pdk2.dtb"

do_rootfs[depends] += "imx6-dhcom-pdk2-ulinuxenvtxt:do_deploy"
```

## layers/meta-dhcom_imx6/conf/machine/dhcom4bimx6q.conf
```bitbake
#@TYPE: Machine
#@NAME: DHCOM i.MX6 Quad
#@SOC: i.MX6Q
#@DESCRIPTION: Machine configuration for DHCOM i.MX6 Quad HW400

require conf/machine/include/dhcom_imx6-common.inc


SOC_FAMILY = "mx6:mx6q"

UBOOT_CONFIG ??= "q"
UBOOT_CONFIG[q] = "dh_imx6q_config"

KERNEL_DEVICETREE = "imx6q-dhcom4B-pdk2.dtb"

do_rootfs[depends] += "imx6-dhcom-pdk2-ulinuxenvtxt:do_deploy"
```

## layers/meta-dhcom_imx6/conf/machine/dhcom4bimx6s.conf
```bitbake
#@TYPE: Machine
#@NAME: DHCOM i.MX6 Solo
#@SOC: i.MX6S
#@DESCRIPTION: Machine configuration for DHCOM i.MX6 Solo HW400

require conf/machine/include/dhcom_imx6-common.inc

# Solo is a Duallite internally but single core.
SOC_FAMILY = "mx6:mx6dl"

UBOOT_CONFIG ??= "solo"
UBOOT_CONFIG[solo] = "dh_imx6s_config"

KERNEL_DEVICETREE = "imx6s-dhcom4B-pdk2.dtb"

do_rootfs[depends] += "imx6-dhcom-pdk2-ulinuxenvtxt:do_deploy"
```

## layers/meta-dhcom_imx6/conf/machine/include/dhcom_imx6-common.inc
```bitbake
# Provides the DHCOM i.MX6 common settings

require conf/machine/include/imx-base.inc
require conf/machine/include/tune-cortexa9.inc

PREFERRED_PROVIDER_virtual/bootloader = "u-boot-imx6-dhcom"
PREFERRED_PROVIDER_u-boot = "u-boot-imx6-dhcom"
PREFERRED_VERSION_u-boot-imx6-dhcom = "v2015.10"
IMAGE_BOOTLOADER ?= "u-boot"
#do_rootfs[depends] += "bootscript:do_deploy"
do_rootfs[depends] += "splash:do_deploy"
do_rootfs[depends] += "settings-13-fg0700g3dssw:do_deploy"
BOOT_SCRIPTS += "uLinuxEnv.txt 800x480_done.bmp 800x480_error.bmp 800x480_progress.bmp splash.bmp settings.bin"

UBOOT_MAKE_TARGET = "u-boot.imx"
UBOOT_BINARY = "u-boot.imx"

# override boot partition size 50MB and volume-id
BOOT_SPACE = "51200"
BOOTDD_VOLUME_ID ?= "boot"

# Use linux kernel iMX6 dhcom
PREFERRED_PROVIDER_virtual/kernel = "linux-imx6-dhcom"
PREFERRED_VERSION_linux-imx6-dhcom = "4.1.15"
KERNEL_IMAGETYPE = "zImage"

SERIAL_CONSOLE = "115200 ttymxc0"

MACHINE_FIRMWARE_append_mx6 = " linux-firmware-ath6k"
MACHINE_FEATURES += " pci wifi bluetooth"

#MACHINE_EXTRA_RRECOMMENDS_append = " kernel-modules"

SOC_DEFAULT_IMAGE_FSTYPES = "tar.bz2 sdcard"
SDCARD_ROOTFS = "${DEPLOY_DIR_IMAGE}/${IMAGE_NAME}.rootfs.ext3"
```

## layers/meta-resin-dhcom4bimx6q/conf/layer.conf
```bitbake
BBPATH .= ":${LAYERDIR}"

BBFILES += "${LAYERDIR}/recipes-*/*/*.bb \
            ${LAYERDIR}/recipes-*/*/*.bbappend"

BBFILE_COLLECTIONS += "resin-dhcom4bimx6q"
BBFILE_PATTERN_resin-dhcom4bimx6q := "^${LAYERDIR}/"
BBFILE_PRIORITY_resin-dhcom4bimx6q = "1337"

IMAGE_INSTALL_remove = "fsl-rc-local"
```
